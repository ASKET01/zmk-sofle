## boards/arm/eyelash_sofle/eyelash_sofle_left_defconfig
```kconfig
# Copyright (c) 2022 Darryl deHaan
# SPDX-License-Identifier: MIT

CONFIG_SOC_SERIES_NRF52X=y
CONFIG_SOC_NRF52840_QIAA=y
CONFIG_BOARD_EYELASH_SOFLE_LEFT=y

# --- Power & Sleep ---
CONFIG_ZMK_SLEEP=y

# --- Core peripherals ---
CONFIG_ARM_MPU=y
CONFIG_PINCTRL=y
CONFIG_GPIO=y
CONFIG_SPI=y

# --- Flash / boot / UF2 ---
CONFIG_USE_DT_CODE_PARTITION=y
CONFIG_BUILD_OUTPUT_UF2=y
CONFIG_FLASH=y
CONFIG_FLASH_MAP=y
CONFIG_FLASH_PAGE_LAYOUT=y
CONFIG_MPU_ALLOW_FLASH_WRITE=y
CONFIG_NVS=y
CONFIG_SETTINGS_NVS=y

# --- Clock ---
CONFIG_CLOCK_CONTROL_NRF_K32SRC_XTAL=y
CONFIG_CLOCK_CONTROL_NRF_K32SRC_30PPM=y

# --- USB / BLE / SPLIT ---
CONFIG_ZMK_USB=y
CONFIG_ZMK_BLE=y
CONFIG_BT=y
CONFIG_BT_PERIPHERAL=y
CONFIG_ZMK_SPLIT=y
CONFIG_ZMK_SPLIT_BLE=y
CONFIG_ZMK_SPLIT_ROLE_CENTRAL=y

# --- Display (OLED Eyelash) ---
CONFIG_ZMK_DISPLAY=y

# --- External Power ---
CONFIG_ZMK_EXT_POWER=y

# --- BLE options ---
CONFIG_ZMK_BLE_PASSKEY_ENTRY=n
CONFIG_ZMK_BLE_CLEAR_BONDS_ON_START=n

# --- USB naming ---
CONFIG_USB_DEVICE_MANUFACTURER="sofle"

# --- Radio power boost ---
CONFIG_BT_CTLR_TX_PWR_PLUS_8=y

# --- HID ---
CONFIG_ZMK_HID_REPORT_TYPE_NKRO=n

# --- Encoder ---
CONFIG_EC11=y
CONFIG_EC11_TRIGGER_GLOBAL_THREAD=y
CONFIG_ZMK_POINTING=y
```
